/*
 * sofia. lcd-claa070wp03xg
 * definition at "include/dt-bindings/sofiafb/sofia_fb.h"
 */

	display-timings {
		native-mode = <&timing0>;
		timing0: timing0 {
			screen-type = <SCREEN_RGB>;
			lvds-format = <LVDS_8BIT_2>;
			out-face    = <OUT_P888>;
			color-mode = <COLOR_RGB>;
			clock-frequency = <48000000>;
			hactive = <1024>;
			vactive = <600>;
			hback-porch = <102>;
			hfront-porch = <102>;
			vback-porch = <24>;
			vfront-porch = <12>;
			hsync-len = <12>;
			vsync-len = <4>;
			hsync-active = <0>;
			vsync-active = <0>;
			de-active = <0>;
			pixelclk-active = <0>;
			swap-rb = <0>;
			swap-rg = <0>;
			swap-gb = <0>;
		};
	};
