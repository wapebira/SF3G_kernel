/*
 * sofia. lcd-mipi_nt35521.dtsi
 * screen timing definition.
 * definition at "include/dt-bindings/sofiafb/sofia_fb.h"
 */

	display-timings {
		native-mode = <&timing0>;
		timing0: timing0 {
			screen-type = <SCREEN_MIPI>;
			lvds-format = <LVDS_8BIT_2>;
			out-face    = <OUT_P888>;
			color-mode = <COLOR_RGB>;
			clock-frequency = <70000000>;
			hactive = <800>;
			vactive = <1280>;
			hback-porch = <4>;
			hfront-porch = <40>;
			vback-porch = <20>;
			vfront-porch = <20>;
			hsync-len = <40>;
			vsync-len = <4>;
			hsync-active = <0>;
			vsync-active = <0>;
			de-active = <0>;
			pixelclk-active = <0>;
			swap-rb = <0>;
			swap-rg = <0>;
			swap-gb = <0>;
		};
	};
