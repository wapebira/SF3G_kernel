lmmc1:pm@0 {
	compatible = "intel,regulator-device-pm";
	regulator-name = "lmmc1";
	regulator-min-microvolt = < 1200000 >;
	regulator-max-microvolt = < 2900000 >;
	intel,class_name = "usd_class";
	intel,user_name = "usd_card";
	intel,states = "disable", "mid_perf", "high_perf";
	intel,voltages = <0 1800000 2900000>;

};
lemmc:pm@1 {
	compatible = "intel,regulator-device-pm";
	regulator-name = "lemmc";
	regulator-min-microvolt = < 1200000 >;
	regulator-max-microvolt = < 2900000 >;
	intel,class_name = "emmc_class";
	intel,user_name = "emmc_card";
	intel,states = "disable", "mid_perf", "high_perf";
	intel,voltages = <0 1800000 2900000>;

};
pm_lcd:pm@2 {
	compatible = "intel,regulator-device-pm";
	regulator-name = "lcd";
	regulator-min-microvolt = < 1200000 >;
	regulator-max-microvolt = < 2900000 >;
	intel,class_name = "generic_class";
	intel,user_name = "lcd";
	intel,states = "disable", "enable";
	intel,voltages = <0 2900000>;
};
