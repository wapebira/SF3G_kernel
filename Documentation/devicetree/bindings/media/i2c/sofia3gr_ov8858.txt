## drivers/compat_iwlwifi/drivers/net/wireless/iwlwifi/Kconfig.noupstream
```kconfig
config IWLXVT
	tristate "Enable XVT op_mode"
	depends on m
	select IWLWIFI_DEVICE_TESTMODE
	select IWLWIFI_SUPPORT_DEBUG_OVERRIDES
	help
	  This option enables the xVT operation mode. xVT mode supports
	  special debug and testing operations that are not supported in
	  the standard operation modes, and is used for verification
	  purposes.
	  xVT mode does not support the standard WiFi operations, and
	  does not communicate with the user mode through the nl80211.

	  Enabling this options allows to fully control the HW using
	  an external tool in user space.

	  Say Y if you have the user space application and want
	  to execute debug and testing flows on the HW.

config IWLTEST
	tristate "Transport tester mode on"
	depends on IWLWIFI
	depends on IWLWIFI_DEBUGFS
	depends on m
	help
	  This option enables the trans_test operation mode. This mode
	  allows to test data path on the transport layer itself, and
	  its loopback with the firmware, isolated from the rest of the
	  stack.

config IWLWIFI_IDI
	bool "Enable IDI bus support"
	depends on IDI
	depends on IWLWIFI
	select IWLWIFI_MINI_PM_RUNTIME

config IWLWIFI_NUM_CHANNELS
	int "number of supported concurrent channels"
	range 1 2
	default 2
	depends on IWLMVM

config IWLMVM_POWER_SCHEME
        int "power scheme mode: 1 CAM, 2 BPS, 3 LP"
        range 1 3
        default 2
        depends on IWLMVM
	---help---
	  power scheme modes:
	  1 - Continous Active Mode (CAM):  Power save is disabled.
	  2 - Balanced Power Save (BPS): the default mode.
	      for power saving with least influence on performance.
	  3 - Low Power (LP): Best power saving mode with possible performance degradation.
	  This value might get overridden by power_scheme module_param if exists.

config IWLWIFI_DEVICE_TESTMODE
	bool "enable generic netlink testmode support"
	default y if IWLMVM
	select IWLWIFI_SUPPORT_DEBUG_OVERRIDES

config IWLWIFI_FRQ_MGR
	bool "enable Frequency Manager API"
	depends on IWLMVM && IUI_FM
	help
	  This option enables The Frequency Manager API.
	  Enabling this option allows the driver to receive and send
	  Frequency notification from and to the Frequency Manager.
	  The notification can involve Tx power, Rx gain, and ADC/DAC

config IWLWIFI_SUPPORT_DEBUG_OVERRIDES
	bool "enable default value override (for debugging)"

config IWLWIFI_PCIE_SUSPEND_RESUME
	bool "enable PCIe suspend/resume code workarounds"
	depends on IWLWIFI_PCIE
	# Intel Media requires this
	default y if CONFIG_ARCH_GEN3
	help
	  Enable this option if your base kernel has broken PCI(e)
	  suspend/resume code and the driver has to work around it
	  or if you need the driver to store and restore the PCIe
	  configuration for other reasons.

config IWLWIFI_INTEGRATE_SUSPEND_RESUME
	bool "integrate suspend/resume into the driver"
	depends on IWLMVM && PM_SLEEP
	help
	  Enable this option if for some reason you cannot rely on
	  the kernel calling the wiphy's suspend/resume function at
	  the right place. Don't enable this unless you need it.

config IWLWIFI_MVM_RFKILL_ON_SUSPEND
	bool "pretend device is in RF-kill during suspend"
	depends on IWLMVM && IWLWIFI_PCIE
	select IWLWIFI_INTEGRATE_SUSPEND_RESUME
	help
	  Enable this option if for some reason you require the
	  device to pretend it's in RF-kill while suspended. This
	  should normally not be necessary.

	  Note that selecting this option will disable WoWLAN and
	  actually remove the feature completely.

config IWLWIFI_MINI_PM_RUNTIME
	bool "internal mini-runtime PM implementation"
	depends on IWLWIFI
	depends on !PM_RUNTIME
	help
	  Enable use of an internal reference counting framework for the
	  purpose of getting the FW and bus into a low power state when
	  the WiFi component is idle.

config IWLMVM_P2P_OPPPS_TEST_WA
	bool "Use WA to pass P2P OPPPS certification test"
	depends on IWLMVM
	default n
	---help---
	  This option enables a WA to pass P2P OPPPS certification test.
	  This test verifies P2P client power management behavior when
	  connected to P2P GO that advertises OPPPS. Since P2P client power
	  management is not supported currently by FW a special WA is required.
	  Send zeroed quota on P2P client MAC if power save is enabled from
	  user space to mimic power management behavior. Update quota to normal
	  value otherwise.

config IWLMVM_TCM
	bool "enable traffic conditions monitoring"
	depends on IWLMVM
	default y
	help
	  This option enables (vendor) events to userspace and traffic
	  monitoring for low-latency and traffic thresholds, as well as
	  their impact on quota and other submodules.
```

## drivers/gnss/Kconfig
```kconfig
#
# drivers (GPS)
#
menu "GNSS device drivers"
config GNSS_AG620
	tristate "AG620 driver"
	help
	  AG620.

endmenu
```

## drivers/input/sensors/psensor/Kconfig
```kconfig
#
# light and position sensor drivers configuration
#

menuconfig PROXIMITY_DEVICE
	bool "proximity sensor device support"
	default y	

if PROXIMITY_DEVICE

config PS_AL3006
  bool "psensor al3006"
	default n

config PS_STK3171
  bool "psensor stk3171"
	default n

config PS_AP321XX
  bool "psensor ap321xx"
	default n

config PS_TMD2772
  bool "psensor tmd2772"
	default y

config PS_CM36682
  bool "psensor cm36682"
	default y

config PS_RPR0521
  bool "psensor rpr0521"
	default y
endif
```

## drivers/input/touchscreen/gt615/Kconfig
```kconfig
config TOUCHSCREEN_GT615
	tristate "goodix gt615 touchscreen"
	depends on I2C
	default n
	help
	  Say Y here if you have a goodix gt615 touchscreen.
```

## drivers/input/touchscreen/gt9157/Kconfig
```kconfig
config TOUCHSCREEN_GT9157
        tristate "goodix gt9157 touchscreen"
        depends on I2C
        default n
        help
          Say Y here if you have a goodix gt9157 touchscreen.
```

## drivers/input/touchscreen/icn83xx/Kconfig
```kconfig
config TOUCHSCREEN_ICN83XX
	tristate "icn83xx touchscreen"
	depends on I2C
	default n
	help
	  Say Y here if you have a icn83xx touchscreen.
```

## drivers/sofia_nand/Kconfig
```kconfig
#
# NAND configuration.
#

config BLOCK_SOFIA3GR_NAND
	tristate "SOFIA3GR NAND Device Support"
	help
	  SOFIA3GR NAND Device Support
```

## drivers/video/rockchip/Kconfig
```kconfig
menuconfig FB_ROCKCHIP
	tristate "Rockchip Framebuffer Display support"
	depends on FB
	select FB_CFB_FILLRECT
	select FB_CFB_COPYAREA
	select FB_CFB_IMAGEBLIT
	select FB_MODE_HELPERS
	select VIDEOMODE_HELPERS
	default n
	help
	  Enable Rockchip Framebuffer Display driver
	  for sofia 3gr platform.
	  Please choose Y to enable rockchip
	  framebuffer driver.

source "drivers/video/rockchip/vop/Kconfig"
source "drivers/video/rockchip/rga/Kconfig"
source "drivers/video/rockchip/hdmi/Kconfig"

config LVDS_RK61X
        tristate "RK61X(JettaB) lvds,lcd,scaler video interface support"
	depends on MFD_RK61X && FB_ROCKCHIP
	default n
	help
	  RK61X(Jetta B) LVDS,LCD,scaler transmitter support.
```

## drivers/video/rockchip/hdmi/chips/Kconfig
```kconfig
config  HDMI_CAT66121
        bool "CAT66121 HDMI support"
        help
           Support cat66121 hdmi if you say y here

if HDMI_CAT66121
source "drivers/video/rockchip/hdmi/chips/cat66121/Kconfig"
endif
```
