## Documentation/devicetree/bindings/media/i2c/sofia3gr_ov8858.txt
```
        afc0: af-controller@0 {
                compatible = "analog devices,ad5823-v4l2-i2c-subdev";
                reg = < 0x0C >;
        };

        camera0: camera-module@0 {
                compatible = "omnivision,OV8858-v4l2-i2c-subdev";
                reg = < 0x10 >;/*addr is 0x6C when SID set 0,else is 0x20*/
                device_type = "v4l2-i2c-subdev";

                pinctrl-names = "default", "sleep", "inactive";
                pinctrl-0 = <&cam1_default_pins>;
                pinctrl-1 = <&cam1_sleep_pins>;
                pinctrl-2 = <&cam1_inactive_pins>;

                intel,pd-gpio = <&xgold_pmx_gpio 14 0>;
                //intel,pd-gpio_1v2 = <&xgold_pmx_gpio 68 0>;
                intel,pd-gpio-is_active_low;
                intel,flash-gpio = <&xgold_pmx_gpio 37 0>;
                intel,torch-gpio = <&xgold_pmx_gpio 38 0>;

                pm,class-name = "generic_class";
                pm,user-name = "primcam";
                pm,state-D0 = "enable";
                pm,state-D3 = "disable";


                intel,camera-module-facing = "back";
                intel,camera-module-mounting = "landscape";
                intel,camera-module-flash-support = <1>;
                intel,camera-module-flash-exp-time = <5000>;

                //intel,af-ctrl = <&afc0>;
                intel,camera-module-csi-config-0 {
                        intel,csi-pixels-per-second = <0>;
                        intel,csi-vc = <0>;
                        intel,csi-lanes = <2>;
                        intel,csi-dphy1 = <0x2014183>;
                        intel,csi-dphy2 = <0x00>;
                        intel,csi-ana-bandgap-bias = <3>;
                };
                intel,camera-module-csi-config-1 {
                        intel,csi-pixels-per-second = <100000000>;
                        intel,csi-vc = <0>;
                        intel,csi-lanes = <4>;
                        intel,csi-dphy1 = <0x600E1C1>;
                        intel,csi-dphy2 = <0x00>;
                        intel,csi-ana-bandgap-bias = <3>;
                };
        };
```

## Documentation/devicetree/bindings/media/i2c/sofia3gr_vm149c.txt
```
Required Properties :
- compatible: Must be "silicon touch,vm149C-v4l2-i2c-subdev"

Example:

afc0: af-controller@0 {
		compatible = "silicon touch,vm149C-v4l2-i2c-subdev";
		reg = < 0x0c >;
};
```

## Documentation/devicetree/bindings/mfd/rk818.txt
```
RK818 Power Management Integrated Circuit

Required properties:
- compatible: "rockchip,rk818"
- reg: here use vmm i2c, don't need 
- interrupt-parent: The parent interrupt controller.
- interrupts: the interrupt outputs of the controller.
- pinctrl-names, pinctrl-0, pinctrl-1,pinctrl-2: See <Documentation/devicetree/bindings/pinctrl/pinctrl-bindings.txt> for detail.
- ocv_table: depend on the battery used
- design_capacity: depend on the battery used
- design_qmax: depend on the battery used
- max_overcharge: depend on rk818 spec
- max_charge_currentmA: depend on rk818 spec
- max_charge_voltagemV: depend on rk818 spec
- max_bat_voltagemV: depend on the battery used
- sleep_enter_current: depend on rk818 spec
- sleep_exit_current: depend on rk818 spec


Example:
rk818  {
		compatible = "rockchip,rk818";
		status = "okay";
		interrupt-parent = <&eint>;
		interrupts = < EINT_EXI3 XGOLD_IRQ_TYPE_EDGE_FALLING >;
		pinctrl-names = "default", "sleep", "inactive";
		pinctrl-0 = <&pmu_default_pins>;
		pinctrl-1 = <&pmu_sleep_pins>;
		pinctrl-2 = <&pmu_inactive_pins>;
		battery {
			ocv_table = <3350 3677 3693 3719 3752 3770 3775 3778 3785 3796 3812 3839 3881 3907 3933 3958 3978 4033 4087 4123 4174>;
			design_capacity = <4000>;
			design_qmax = <4100>;
			max_overcharge = <100>;
			max_charge_currentmA = <1500>;
			max_charge_voltagemV = <4260>;
			max_bat_voltagemV = <4200>;
			sleep_enter_current = <150>;
			sleep_exit_current = <180>;
		};
	};
```

## Documentation/devicetree/bindings/thermal/ag620_thermal.txt
```
* SoFIA-3GR AG620 Thermal Management Unit (TMU)

** Required properties:

- compatible : should be "intel,ag620_thermal".

Example:

ag620_thermal {
	compatible = "intel,ag620_thermal";
};
```

## Documentation/devicetree/bindings/x86/prh.txt
```
VMM prh

Required properties:
- compatible: "intel,prh_vmm"
- prh_display: here is display prh which set the voltage for the virtual domain.
- mipi_ana: set PMIC_VDD_PRIM_DISPLAY voltage.
- mipi_dsi: set PMIC_VDD_MIPI_DSI voltage.
- lvds_io: set PMIC_VDD_LVDS_1V8 voltage.
- mipi_io: set PMIC_VDD_LCD_DSI voltage.

Example:
prh_vmm:prh_vmm {
       compatible = "intel,prh_vmm";
       prh_display {
               mipi_ana = <PMIC_VDD_PRIM_DISPLAY  PMIC_VOLTAGE_3V00>;
               mipi_dsi = <PMIC_VDD_MIPI_DSI  PMIC_VOLTAGE_1V17>;
               lvds_io = <PMIC_VDD_LVDS_1V8  PMIC_VOLTAGE_1V80>;
               mipi_io = <PMIC_VDD_LCD_DSI  PMIC_VOLTAGE_1V80>;
       };
};
```
